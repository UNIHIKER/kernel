/dts-v1/;
/plugin/;

/ {
	compatible = "rockchip,rk3308";
	fragment@1 {
		target = <&i2c1>;
		__overlay__ {
			#address-cells = <1>;
			#size-cells = <0>;
			ds3232@68 {
				compatible = "dallas,ds3232";
				reg = <0x68>;
				status = "okay";
			};
		};
	};
};
